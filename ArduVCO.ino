/**
 * Author: Aaron C. Smith (@clachipso, clachipso@gmail.com)
 * 
 * Copyright 2020 by Aaron C. Smith
 * 
 * Permission is hereby granted, free of charge, to any person obtaining a 
 * copy of this software and associated documentation files (the "Software"), to
 * deal in the Software without restriction, including without limitation the 
 * rights to use, copy, modify, merge, publish, distribute, sublicense, and/or 
 * sell copies of the Software, and to permit persons to whom the Software is 
 * furnished to do so, subject to the following conditions:
 * 
 * The above copyright notice and this permission notice shall be included in 
 * all copies or substantial portions of the Software.
 * 
 * THE SOFTWARE IS PROVIDED "AS IS", WITHOUT WARRANTY OF ANY KIND, EXPRESS OR 
 * IMPLIED, INCLUDING BUT NOT LIMITED TO THE WARRANTIES OF MERCHANTABILITY, 
 * FITNESS FOR A PARTICULAR PURPOSE AND NONINFRINGEMENT. IN NO EVENT SHALL THE 
 * AUTHORS OR COPYRIGHT HOLDERS BE LIABLE FOR ANY CLAIM, DAMAGES OR OTHER 
 * LIABILITY, WHETHER IN AN ACTION OF CONTRACT, TORT OR OTHERWISE, ARISING FROM,
 * OUT OF OR IN CONNECTION WITH THE SOFTWARE OR THE USE OR OTHER DEALINGS IN THE 
 * SOFTWARE.
 **/

// This file contains the code for the Arduino Nano that is used in the Magic
// Sword VCO.

#include <stdint.h>

// The types wave tables that the oscillator can generate
enum TableType {
  TABLE_SQR,
  TABLE_QTR,
  TABLE_EIGHTH,
  TABLE_TRI,
  TABLE_SAW,
  NUM_TABLES
};

// 50% duty cycle pulse wave table, used in countless 8bit console sound 
// generators
const uint8_t SQR_TABLE[32] = {
  0x0F, 0x0F, 0x0F, 0x0F, 0x0F, 0x0F, 0x0F, 0x0F,
  0x0F, 0x0F, 0x0F, 0x0F, 0x0F, 0x0F, 0x0F, 0x0F,
  0x00, 0x00, 0x00, 0x00, 0x00, 0x00, 0x00, 0x00,
  0x00, 0x00, 0x00, 0x00, 0x00, 0x00, 0x00, 0x00
};

// 25% duty cycle pulse wave table, inspired from Gameboy and NES sound chips
const uint8_t QTR_TABLE[32] = {
  0x0F, 0x0F, 0x0F, 0x0F, 0x0F, 0x0F, 0x0F, 0x0F,
  0x00, 0x00, 0x00, 0x00, 0x00, 0x00, 0x00, 0x00,
  0x00, 0x00, 0x00, 0x00, 0x00, 0x00, 0x00, 0x00,
  0x00, 0x00, 0x00, 0x00, 0x00, 0x00, 0x00, 0x00
};

// 12.5% duty cycle pulse wave table, inspired from Gameboy and NES sound chips
const uint8_t EIGHTH_TABLE[32] = {
  0x0F, 0x0F, 0x0F, 0x0F, 0x00, 0x00, 0x00, 0x00,
  0x00, 0x00, 0x00, 0x00, 0x00, 0x00, 0x00, 0x00,
  0x00, 0x00, 0x00, 0x00, 0x00, 0x00, 0x00, 0x00,
  0x00, 0x00, 0x00, 0x00, 0x00, 0x00, 0x00, 0x00
};

// Triangle wave table, inspired by the triangle channel of the NES sound 
// generator
const uint8_t TRI_TABLE[32] = {
  0x00, 0x01, 0x02, 0x03, 0x04, 0x05, 0x06, 0x07,
  0x08, 0x09, 0x0A, 0x0B, 0x0C, 0x0D, 0x0E, 0x0F,
  0x0F, 0x0E, 0x0D, 0x0C, 0x0B, 0x0A, 0x09, 0x08,
  0x07, 0x06, 0x05, 0x04, 0x03, 0x02, 0x01, 0x00
};

// 4 bit saw wave table. Gameboy DMG could generate this in its wave channel
// (among many others)
const uint8_t SAW_TABLE[32] = {
  0x00, 0x00, 0x01, 0x01, 0x02, 0x02, 0x03, 0x03,
  0x04, 0x04, 0x05, 0x05, 0x06, 0x06, 0x07, 0x07,
  0x08, 0x08, 0x09, 0x09, 0x0A, 0x0A, 0x0B, 0x0B,
  0x0C, 0x0C, 0x0D, 0x0D, 0x0E, 0x0E, 0x0F, 0x0F
};

// Lookup table for CCR register that times the DDS sample generation timer
const PROGMEM uint16_t TIMER_TABLE[4096]
{
  7644, 7638, 7631, 7625, 7618, 7612, 7605, 7599, 
  7592, 7586, 7580, 7573, 7567, 7560, 7554, 7548, 
  7541, 7535, 7528, 7522, 7516, 7509, 7503, 7497, 
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  240, 240, 240, 239, 239, 239, 239, 239 
};


uint16_t curr_adc_val = 0;
uint16_t timer_val = 500000 / 65;
uint8_t phase_acc = 0;
uint8_t table_type = TABLE_TRI;

bool prev_btn_state = false;

void setup() {
  // Set up DAC related functionality
  DDRB |= 0x0F; // PB0-PB3 are our DAC pins 
  TCCR1A = 0;
  TCCR1B = (1 << WGM12); // CTC Mode, OCR1A is top
  TCCR1B |= (1 << CS10); // Divide clock by 1 for full 16MHz master clock
  TIMSK1 = (1 << OCIE1A); // Enable timer interrupt
  OCR1A = 500000 / 65; // Initial value for 65Hz (lowest C in our range)

  // Initialize waveform selection pushbutton. We'll use normal Arduino
  // stuff here since it isn't performance sensitive
  pinMode(A1, INPUT_PULLUP);

  // Initialize pins for RGB LED to indicate waveform
  pinMode(2, OUTPUT);
  pinMode(3, OUTPUT);
  pinMode(4, OUTPUT);

  // Enable interrupts to start synthesis
  sei();
}

void loop() {
  /**
   * Read in the next CV input value to determine the frequency of the 
   * oscillator. Note that we oversample by 16. The purpose of this is to reduce 
   * the amount of frequency change that 1 LSB can cause. This avoids oscillator 
   * detuning from minor noise on the ADC input. Note that this makes our 
   * effective sample rate low, and audio rate FM is probably going to do some 
   * weird stuff. Vibrato effects from an LFO should work though.
   **/
  uint16_t adc_avg = 0;
  for (int i = 0; i < 16; i++) {
    adc_avg += analogRead(A0);
  }
  adc_avg >>= 2;

  if (adc_avg != curr_adc_val) {
    curr_adc_val = adc_avg;
    timer_val = pgm_read_word_near(TIMER_TABLE + curr_adc_val);
  }

  // We now have a nearly 12 bit sample. Our range is limited from 0-4092, not 4095
  // The reason is that: 1023 * 16 / 4 = 4092.

  // Check pushbutton for waveform select input. We don't use debounce, but 
  // maybe we should?
  uint8_t curr_btn_state = 0;
  if (digitalRead(A1) == HIGH) curr_btn_state = 1;
  if (curr_btn_state == 0 && prev_btn_state == 1) {
    if ((table_type + 1) == NUM_TABLES) table_type = 0;
    else table_type++;
  }
  prev_btn_state = curr_btn_state;

  // Now update RGB LED based on waveform
  switch (table_type) {
    case TABLE_SQR:
      digitalWrite(2, HIGH);
      digitalWrite(3, LOW);
      digitalWrite(4, HIGH);
      break;
    case TABLE_QTR:
      digitalWrite(2, LOW);
      digitalWrite(3, LOW);
      digitalWrite(4, HIGH);
      break;
     case TABLE_EIGHTH:
      digitalWrite(2, LOW);
      digitalWrite(3, HIGH);
      digitalWrite(4, LOW);
      break;
     case TABLE_TRI:
      digitalWrite(2, LOW);
      digitalWrite(3, HIGH);
      digitalWrite(4, HIGH);
      break;
     case TABLE_SAW:
      digitalWrite(2, HIGH);
      digitalWrite(3, LOW);
      digitalWrite(4, LOW);
      break;
  }
}

// Here's where we output the next value to our DAC. We use DDS technique to 
// avoid aliasing, while still getting that sweet quantization noise from the 
// 8bit console days 
ISR(TIMER1_COMPA_vect) {
  const uint8_t *table = SQR_TABLE;
  if (table_type == TABLE_QTR) table = QTR_TABLE;
  else if (table_type == TABLE_EIGHTH) table = EIGHTH_TABLE;
  else if (table_type == TABLE_TRI) table = TRI_TABLE;
  else if (table_type == TABLE_SAW) table = SAW_TABLE;
  
  PORTB = table[phase_acc];
  
  phase_acc++;
  phase_acc &= 0x1F;
  OCR1A = timer_val;
}
